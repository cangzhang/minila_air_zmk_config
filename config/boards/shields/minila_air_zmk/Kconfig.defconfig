## config/boards/shields/minila_air_zmk/Kconfig.defconfig
```kconfig
# Copyright (c) 2022-2024 The ZMK Contributors
# SPDX-License-Identifier: MIT

if SHIELD_MINILA_AIR_ZMK

config ZMK_KEYBOARD_NAME
    default "Minila Air ZMK" 

config SPI
	default y

endif
```

## config/boards/shields/minila_air_zmk/Kconfig.shield
```kconfig
# Copyright (c) 2022-2024 The ZMK Contributors
# SPDX-License-Identifier: MIT

config  SHIELD_MINILA_AIR_ZMK
   def_bool $(shields_list_contains, minila_air_zmk)
```

## config/boards/shields/mlego_m66_rev4/Kconfig.shield
```kconfig
# Copyright (c) 2022-2024 The ZMK Contributors
# SPDX-License-Identifier: MIT

config  SHIELD_MINILA_AIR_ZMK
   def_bool $(shields_list_contains,mlego_m66_rev4)
```
